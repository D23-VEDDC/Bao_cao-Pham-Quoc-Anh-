## 11_10_2026/5_10_TEST/main/Kconfig.projbuild
```kconfig
menu "VEDC AI Debug"

    config VEDC_FORCE_TFLM_REFERENCE
        bool "Force TFLite Micro reference kernels (disable ESP-NN)"
        default n
        help
            Disable ESP-NN optimized kernels so Conv2D/Depthwise/FC/etc. use
            TFLite Micro reference implementations. Use only for A/B validation
            against Python/reference output; keep disabled in the normal fast build.

endmenu

menu "Example Configuration"

    choice DEVELOPMENT_BOARD_SELECTION
        prompt "Select the development board you are using"
        default BOARD_GENERIC
        help
            Select this option to choose the board for this example.

        config ESP32_S3_USB_OTG
            bool "ESP32 S3 USB OTG"

        config BOARD_GENERIC
            bool "BOARD GENERIC"

    endchoice

    menu "WiFi and server settings"
        config VEDC_AP_SSID
            string "ESP32 access point SSID"
            default "VEDC_ESP32"

        config VEDC_AP_PASSWORD
            string "ESP32 access point password"
            default "vedc1234"

        config VEDC_WIFI_SSID
            string "WiFi SSID"
            default ""

        config VEDC_WIFI_PASSWORD
            string "WiFi password"
            default ""

        config VEDC_SERVER_UPLOAD_URL
            string "Inspection server upload URL"
            default ""
    endmenu

endmenu
```

## 2_10_2026/ESP32S3_VEDC_UART1_SIM/ESP32S3_VEDC_UART1_SIM/main/Kconfig.projbuild
```kconfig
menu "VEDC AI Debug"

    config VEDC_FORCE_TFLM_REFERENCE
        bool "Force TFLite Micro reference kernels (disable ESP-NN)"
        default n
        help
            Disable ESP-NN optimized kernels so Conv2D/Depthwise/FC/etc. use
            TFLite Micro reference implementations. Use only for A/B validation
            against Python/reference output; keep disabled in the normal fast build.

endmenu

menu "Example Configuration"

    choice DEVELOPMENT_BOARD_SELECTION
        prompt "Select the development board you are using"
        default BOARD_GENERIC
        help
            Select this option to choose the board for this example.

        config ESP32_S3_USB_OTG
            bool "ESP32 S3 USB OTG"

        config BOARD_GENERIC
            bool "BOARD GENERIC"

    endchoice

    menu "WiFi Settings"
        config ESP_WIFI_SOFTAP_SSID
            string "WiFi SoftAP SSID"
            default "USB-AV-DEMO"
            help
                SoftAP SSID created by this example.

        config ESP_WIFI_SOFTAP_PASSWORD
            string "WiFi SoftAP Password"
            default ""
            help
                SoftAP password. Leave empty to use an open network.

        config ESP_WIFI_SOFTAP_MAX_STA
            int "Maximal STA connections"
            default 1
            range 1 10
            help
                Maximum number of stations that can connect to the SoftAP.

        config ESP_WIFI_AP_CHANNEL
            int "WiFi SoftAP Channel"
            default 6
            range 1 13
            help
                SoftAP Wi-Fi channel.
    endmenu

endmenu
```
